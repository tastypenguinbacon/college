/*@!Encoding:1250*/

void changeStreetLights(int lightID, int green, int yellow, int red) {
    switch(lightID) {
        case 1:
            putValue(green_1, green);
            putValue(yellow_1, yellow);
            putValue(red_1, red);
            break;
        case 2:
            putValue(green_2, green);
            putValue(yellow_2, yellow);
            putValue(red_2, red);
            break;
        case 3:
            putValue(green_3, green);
            putValue(yellow_3, yellow);
            putValue(red_3, red);
            break;
        case 4:
            putValue(green_4, green);
            putValue(yellow_4, yellow);
            putValue(red_4, red);
            break;
        case 5:
            putValue(green_5, green);
            putValue(yellow_5, yellow);
            putValue(red_5, red);
            break;
        case 6:
            putValue(green_6, green);
            putValue(yellow_6, yellow);
            putValue(red_6, red);
            break;
        case 7:
            putValue(green_7, green);
            putValue(yellow_7, yellow);
            putValue(red_7, red);
            break;
        case 8:
            putValue(green_8, green);
            putValue(yellow_8, yellow);
            putValue(red_8, red);
            break;
    }
}

void changePedestrianLights(int lightID, int state) {
    switch(lightID) {
        case 1:
           putValue(stripes_1, state);
            break;
        case 2:
            putValue(stripes_2, state);
            break;
        case 3:
            putValue(stripes_3, state);
            break;
        case 4:
            putValue(stripes_4, state);
            break;
        case 5:
            putValue(stripes_5, state);
            break;
    }
}

void resetLights() {
    int i;
    for(i = 1; i <= 8; i++)
        changeStreetLights(i, 0, 0, 1);
    for(i = 1; i <= 5; i++)
        changePedestrianLights(i, 0);
}

void setCycle() { 
    resetLights();
    switch(getValue(currState)) { 
        case 1: 
            changeStreetLights(2,1,0,0);
            changeStreetLights(5,1,0,0);
            changeStreetLights(6,1,0,0);
            changeStreetLights(8,1,0,0);
            changePedestrianLights(2,1);
            changePedestrianLights(4,1);
            break;
        case 2:
            changeStreetLights(3,1,0,0);
            changeStreetLights(4,1,0,0);
            changePedestrianLights(3,1);
            changePedestrianLights(5,1);
            break;
        case 3:
            changeStreetLights(7,1,0,0);
            changeStreetLights(8,1,0,0);
            changePedestrianLights(1,1);
            changePedestrianLights(2,1);
            changePedestrianLights(4,1);
            break;
        case 4:
            changeStreetLights(1,1,0,0);
            changeStreetLights(2,1,0,0);
            changePedestrianLights(2,1);
            changePedestrianLights(5,1);
            break;
    }
}

void endCycle() { 
    resetLights();
    switch(getValue(currState)) {
        case 1:
            changeStreetLights(2,0,1,0);
            changeStreetLights(5,0,1,0);
            changeStreetLights(6,0,1,0);
            changeStreetLights(8,0,1,0);           
            break;
        case 2:
            changeStreetLights(3,0,1,0);
            changeStreetLights(4,0,1,0);
            break;
        case 3:
            changeStreetLights(7,0,1,0);
            changeStreetLights(8,0,1,0);
            break;
        case 4:
            changeStreetLights(1,0,1,0);
            changeStreetLights(2,0,1,0);
            break;
    }
}

void setNextToBegin(int cycleID) { 
    int temp;
    temp = getValue(prevState);
    putValue(currState, cycleID);
    switch(cycleID) { 
        case 1:
            if(temp == 1) {
                setCycle();
                break;
            }
            if(temp == 4)
                changeStreetLights(2, 1, 0, 0);
            else 
                changeStreetLights(2, 0, 1, 1);
            if(temp == 3) {
                changeStreetLights(8, 1, 0, 0);
                changePedestrianLights(4, 1);
            }
            else
                changeStreetLights(8, 0, 1, 1);
            if(temp == 3 || temp == 4)
                changePedestrianLights(2, 1);
            changeStreetLights(5, 0, 1, 1);
            changeStreetLights(6, 0, 1, 1);
            break;
        case 2:
            if(temp == 2) {
                setCycle();
                break;
            }
            changeStreetLights(3, 0, 1, 1);
            changeStreetLights(4, 0, 1, 1);
            if(temp == 4)
                changePedestrianLights(5, 1);
            break;
        case 3:
            if(temp == 3) {
                setCycle();
                break;
            }
            if(temp == 1) { 
                changePedestrianLights(4, 1);
                changeStreetLights(8, 1, 0, 0);
            } else 
                changeStreetLights(8, 0, 1, 1);
            changeStreetLights(7, 0, 1, 1);
            if(temp == 1 || temp == 4)
                changePedestrianLights(2, 1);
            break;
        case 4:
            if(temp == 4) {
                setCycle();
                break;
            }
            if(temp == 1)
                changeStreetLights(2, 1, 0, 0);
            else
                changeStreetLights(2, 0, 1, 1);
            changeStreetLights(1, 0, 1, 1);
            if(temp == 1 || temp == 3)
                changePedestrianLights(2, 1);
            if(temp == 2)
                changePedestrianLights(5, 1);
            break;
    }
    putValue(prevState, cycleID);
}